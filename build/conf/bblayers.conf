## build/conf/bblayers.conf
```bitbake
# POKY_BBLAYERS_CONF_VERSION is increased each time build/conf/bblayers.conf
# changes incompatibly
POKY_BBLAYERS_CONF_VERSION = "2"

BBPATH = "${TOPDIR}"
BBFILES ?= ""

# Root directory of the project (parent of build directory)
YOCTO_ROOT := "${TOPDIR}/.."

BBLAYERS ?= " \
  ${YOCTO_ROOT}/poky/meta \
  ${YOCTO_ROOT}/poky/meta-poky \
  ${YOCTO_ROOT}/poky/meta-yocto-bsp \
  ${YOCTO_ROOT}/meta-joe \
  "
```

## meta-joe/conf/layer.conf
```bitbake
# We have a conf and classes directory, add to BBPATH
BBPATH .= ":${LAYERDIR}"

# We have recipes-* directories, add to BBFILES
BBFILES += "${LAYERDIR}/recipes-*/*/*.bb \
            ${LAYERDIR}/recipes-*/*/*.bbappend"

BBFILE_COLLECTIONS += "joe"
BBFILE_PATTERN_joe = "^${LAYERDIR}/"
BBFILE_PRIORITY_joe = "6"

LAYERDEPENDS_joe = "core"
LAYERSERIES_COMPAT_joe = "kirkstone"

# Location to local sources
JOE_SRC = "${LAYERDIR}/src"
JOE_INSTALL_SCRIPTS = "/joe/scripts"
JOE_INSTALL_BIN = "/joe/bin"

# Add helloworld package to rootfs
IMAGE_INSTALL:append = " \
                        helloworld \
                        joe-init \
                        joe-tools \
                        "

# Add kernel-module-sample-oot package to rootfs
MACHINE_ESSENTIAL_EXTRA_RDEPENDS:append = " kernel-module-sample-oot \
                                            kernel-module-joe-leds"
```
